## firmware/main/Kconfig.projbuild
```kconfig
menu "HTTPD PoC Connection Configuration"
    config HTTPD_WIFI_SSID
        string "WiFi SSID"
        default "myssid"
        help
            SSID (network name) for the device to connect to.

    config HTTPD_WIFI_PASSWORD
        string "WiFi Password"
        default "mypassword"
        help
            WiFi password (WPA or WPA2) for the device to use.
            Can be left blank if the network has no security set.
	config HTTPD_HTTP_PORT
		int "HTTP Server Port"
		default 80
		range 1 65535
		help
			Port number for the HTTP server.
	config HTTPD_MDNS_NAME
		string "mDNS Name"
		default "mydevice"
		help
			Name to register with mDNS.
endmenu
```
